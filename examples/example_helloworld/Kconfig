## examples/example_helloworld/Kconfig
```kconfig
menuconfig EZIOT_EXAMPLES_HELLOWORLD_ENABLE
    bool "Enable example helloworld"
    default n
    depends on EZIOT_EXAMPLES_ENABLE
```

## examples/example_kv/Kconfig
```kconfig
menuconfig EZIOT_EXAMPLES_KV_ENABLE
    bool "Enable example kv"
    default n
    depends on EZIOT_EXAMPLES_ENABLE
```

## examples/example_online/Kconfig
```kconfig
menuconfig EZIOT_EXAMPLES_ONLINE_ENABLE
    bool "Enable example online"
    default n
    depends on EZIOT_EXAMPLES_ENABLE
```

## examples/example_ota/Kconfig
```kconfig
menuconfig EZIOT_EXAMPLES_OTA_ENABLE
    bool "Enable example ota"
    default n
    depends on EZIOT_EXAMPLES_ENABLE
```

## examples/example_prop/Kconfig
```kconfig
menuconfig EZIOT_EXAMPLES_PROP_ENABLE
    bool "Enable example prop"
    default n
    depends on EZIOT_EXAMPLES_ENABLE
```

## examples/template_app_bulb/Kconfig
```kconfig
menuconfig EZIOT_EXAMPLES_BULB_ENABLE
    bool "Enable example bulb"
    default n
    depends on EZIOT_EXAMPLES_ENABLE
```

## examples/template_app_bulb/app_compiler_config/sdkconfig.defaults
```kconfig
CONFIG_ESP_SYSTEM_EVENT_TASK_STACK_SIZE=6144
CONFIG_ESP32_PTHREAD_TASK_STACK_SIZE_DEFAULT=4096
CONFIG_FREERTOS_TIMER_TASK_STACK_DEPTH=4096
CONFIG_BTC_TASK_STACK_SIZE=6144
CONFIG_BT_BTC_TASK_STACK_SIZE=6144
```

## examples/template_app_gateway/Kconfig
```kconfig
menuconfig EZIOT_EXAMPLES_GATEWAY_ENABLE
    bool "Enable example gateway"
    default n
    depends on EZIOT_EXAMPLES_ENABLE
```

## eziot/core/Kconfig
```kconfig
menu "ez-iot core configuration"
    config EZIOT_CORE_ENABLED
        bool "Enable ez-iot core"
        default y
endmenu
```

## eziot/extensions/dev_bind/Kconfig
```kconfig
menu "ez-iot extension bind configuration"
    config EZIOT_EXT_BIND_ENABLED
        bool "Enable ez-iot extension bind"
        default y
endmenu
```

## eziot/extensions/dev_model/Kconfig
```kconfig
menu "ez-iot extension model configuration"
    config EZIOT_EXT_MODEL_ENABLED
        bool "Enable ez-iot extension model"
        default y
endmenu
```

## eziot/extensions/ota/Kconfig
```kconfig
menu "ez-iot extension ota configuration"
    config EZIOT_EXT_OTA_ENABLED
        bool "Enable ez-iot extension ota"
        default y
endmenu
```

## eziot/ez_iot_bm/base/Kconfig
```kconfig
menu "ez-iot base configuration"
    config EZIOT_BASE_ENABLE
        bool "Enable ez-iot base"
        default y

endmenu
```

## eziot/ez_iot_bm/hub/Kconfig
```kconfig
menu "ez-iot hub configuration"
    config EZIOT_HUB_ENABLE
        bool "Enable ez-iot hub"
        default y

endmenu
```

## eziot/ez_iot_bm/model/Kconfig
```kconfig
menu "ez-iot model configuration"
    config EZIOT_MODEL_ENABLE
        bool "Enable ez-iot model"
        default y

endmenu
```

## eziot/ez_iot_bm/ota/Kconfig
```kconfig
menu "ez-iot ota configuration"
    config EZIOT_OTA_ENABLE
        bool "Enable ez-iot ota"
        default y

endmenu
```

## eziot/ez_iot_bm/shadow/Kconfig
```kconfig
menu "ez-iot shadow configuration"
    config EZIOT_SHADOW_ENABLE
        bool "Enable ez-iot TSL"
        default y

endmenu
```

## eziot/ez_iot_bm/tsl/Kconfig
```kconfig
menu "ez-iot TSL(Thing Specification Language) configuration"
    config EZIOT_TSL_ENABLE
        bool "Enable ez-iot TSL business module"
        default y
        #select EZIOT_CORE_ENABLE

    config EZIOT_TSL_SHADOW_SUPPORT
        bool "Use device shadow to synchronize property"
        default y
        depends on EZIOT_TSL_ENABLE
        select EZIOT_SHADOW_ENABLE

    choice EZIOT_TSL_LEGALITY_CHECK_LEVEL
        prompt "Functional legality check level"
        default EZIOT_TSL_LEGALITY_CHECK_WEAK
        depends on EZIOT_TSL_ENABLE

    config EZIOT_TSL_LEGALITY_CHECK_NONE
        bool "NONE"
    config EZIOT_TSL_LEGALITY_CHECK_WEAK
        bool "WEAK"
    config EZIOT_TSL_LEGALITY_CHECK_STRONG
        bool "STRONG"
    endchoice

    config EZIOT_TSL_DOWNLOAD_TASK_PRIORITY
        int "priority of schema download task"
        range 0 255
        default 5
        depends on EZIOT_TSL_ENABLE

    config EZIOT_TSL_DOWNLOAD_STACK_SIZE
        int "Stack size of schema download task"
        default 16384
        depends on EZIOT_TSL_ENABLE

endmenu
```

## eziot/ez_iot_core/Kconfig
```kconfig
menu "ez-iot core configuration"
    config EZIOT_CORE_ENABLE
        bool "Enable ez-iot core"
        default y

    config EZIOT_CORE_MULTI_TASK
        bool "Work in multi task"
        default y
        depends on EZIOT_CORE_ENABLE

    config EZIOT_CORE_ACEESS_TASK_STACK_SIZE
        int "Stack size of access task"
        default 16384
        depends on EZIOT_CORE_ENABLE
        help
             Stack size for access task, the task is used for device authentication and device access 

    config EZIOT_CORE_ACEESS_TASK_PRIORITY
        int "priority of access task"
        range 0 255
        default 5
        depends on EZIOT_CORE_ENABLE

    config EZIOT_CORE_USER_TASK_STACK_SIZE
        int "Stack size of user task"
        default 16384
        depends on EZIOT_CORE_MULTI_TASK
        help
             Stack size for user task, the task is used for cloud message distribution to application.

    config EZIOT_CORE_USER_TASK_PRIORITY
        int "priority of user task"
        range 0 255
        default 5
        depends on EZIOT_CORE_MULTI_TASK

    config EZIOT_CORE_MESSAGE_BUFFER_MAX
        int "ezviz protocol message buffer size"
        range 256 16384
        default 16384
        depends on EZIOT_CORE_ENABLE

endmenu
```

## eziot/link/Kconfig
```kconfig
menu "ez-iot link configuration"
    config EZIOT_LINK_ENABLED
        bool "Enable ez-iot link"
        default y
endmenu
```

## platform/bsp/Kconfig
```kconfig
config EZIOT_OS_ENABLE
    bool "Enable eziot os interface"
    default y

config EZIOT_OS_BSP_ROOT
    string "bsp path"
    default ""
    depends on EZIOT_OS_ENABLE
```

## platform/bsp/esp32/Kconfig
```kconfig
config EZOS_KV_ENABLE
    bool "Enable ez-os interface kv"
    default y

config EZOS_LIBC_ENABLE
    bool "Enable ez-os interface libc"
    default y

config EZOS_MEM_ENABLE
    bool "Enable ez-os interface memory"
    default y

config EZOS_SOCKET_ENABLE
    bool "Enable ez-os interface socket"
    default y

config EZOS_SYSTEM_ENABLE
    bool "Enable ez-os interface system"
    default y

config EZOS_THREAD_ENABLE
    bool "Enable ez-os interface thread"
    default y

config EZOS_TIME_ENABLE
    bool "Enable ez-os interface time"
    default y
```

## platform/bsp/linux/ezos/Kconfig
```kconfig
config EZIOT_EZOS_ENABLE
    bool "Enable ezos enable"
    default n

config EZOS_KV_ENABLE
    bool "Enable ez-os interface kv"
    default y
    depends on EZIOT_EZOS_ENABLE

config EZOS_LIBC_ENABLE
    bool "Enable ez-os interface libc"
    default y
    depends on EZIOT_EZOS_ENABLE

config EZOS_MEM_ENABLE
    bool "Enable ez-os interface memory"
    default y
    depends on EZIOT_EZOS_ENABLE

config EZOS_SOCKET_ENABLE
    bool "Enable ez-os interface socket"
    default y
    depends on EZIOT_EZOS_ENABLE

config EZOS_SYSTEM_ENABLE
    bool "Enable ez-os interface system"
    default y
    depends on EZIOT_EZOS_ENABLE

config EZOS_THREAD_ENABLE
    bool "Enable ez-os interface thread"
    default y
    depends on EZIOT_EZOS_ENABLE

config EZOS_TIME_ENABLE
    bool "Enable ez-os interface time"
    default y
    depends on EZIOT_EZOS_ENABLE
```

## unit_test/Kconfig
```kconfig
config EZIOT_UNIT_TEST_ENABLE
    bool "Enable Unit Test"
    default n
    select EZIOT_COMPONENT_UTEST_ENABLE

config EZIOT_UNIT_TEST_REPORT_LOGLVL
    int "The log level of the unit test report"
    range 1 2
    default 2
    depends on EZIOT_UNIT_TEST_ENABLE

config EZIOT_UNIT_TEST_SDK_LOGLVL
    int "The log level for debugging"
    range 0 5
    default 0
    depends on EZIOT_UNIT_TEST_ENABLE

config EZIOT_UNIT_TEST_CASE_TIEMOUT_SECONDS
    int "The default timeout of the interface test"
    default 10
    depends on EZIOT_UNIT_TEST_ENABLE

config EZIOT_UNIT_TEST_CLOUD_HOST
    string "Ezviz cloud server address"
    default "devcn.eziot.com"
    depends on EZIOT_UNIT_TEST_ENABLE

config EZIOT_UNIT_TEST_CLOUD_PORT
    int "Ezviz cloud server port"
    default 8666
    depends on EZIOT_UNIT_TEST_ENABLE

config EZIOT_UNIT_TEST_DEV_AUTH_MODE
    int "Device authentication mode"
    range 0 1
    default 1
    depends on EZIOT_UNIT_TEST_ENABLE
    help
        0 means SAP auth mode, 1 means license auth mode

config EZIOT_UNIT_TEST_WIFI_SSID
    string "config Wifi ssid (for wifi module)"
    default "Lee"
    depends on EZIOT_UNIT_TEST_ENABLE

config EZIOT_UNIT_TEST_WIFI_PASSWORD
    string "config Wifi password (for wifi module)"
    default "12345678"
    depends on EZIOT_UNIT_TEST_ENABLE
```
