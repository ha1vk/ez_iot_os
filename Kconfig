## Kconfig
```kconfig
mainmenu "Ezviz Cloud IoT OS configuration"

menu "toolchain configuration"
    config TOOLCHAIN_PATH
        string "toolchain path"
        default ""

    config TOOLCHAIN_PREFIX
        string "toolchain prefix"
        default ""

    config ADD_PRIVATE_CFLAGS
        string "compile cflags"
        default ""

    config ADD_PRIVATE_CXXFLAGS
        string "compile cxxflags"
        default ""

    config ADD_PRIVATE_LINK_CFLAGS
        string "link/ld cflags"
        default ""

    config ADD_PRIVATE_LINK_CXXFLAGS
        string "link/ld cxxflags"
        default ""
endmenu

menu "ez-iot configuration"
    osource "${EZOS_PATH}/eziot/ez_iot_core/Kconfig"
    osource "${EZOS_PATH}/eziot/ez_iot_bm/Kconfig"
endmenu

menu "os/bsp configuration"
    source "${EZOS_PATH}/platform/bsp/Kconfig"
endmenu

menu "components configuration"
    osource "${EZOS_PATH}/components/*/Kconfig"
endmenu

menu "project configuration"
    osource "${PROJECT_KCONFIG_PATH}/Kconfig"
endmenu
```

## apps/ezapp_template/Kconfig
```kconfig
config EZIOT_COMPONENT_APP_NAME
    string "ezapp custom module name"
    default "ezapp"

config EZIOT_COMPONENT_APP_PRODUCTKEY
    string "ezapp custom module name"
    default "11111111111111111111111111"
```

## apps/ezapp_vrv/Kconfig
```kconfig
config EZIOT_COMPONENT_APP_NAME
    string "ezapp custom module name"
    default "ezapp"

config EZIOT_COMPONENT_APP_DEVICE_TYPE
    string "custom device type(for sap auth mode)"
    default ""

config EZIOT_COMPONENT_APP_FWV_MAJOR
    int "The major version of firmware"
    range 0 9
    default 1

config EZIOT_COMPONENT_APP_FWV_MINOR
    int "The minor version of firmware"
    range 0 9
    default 0

config EZIOT_COMPONENT_APP_FWV_MICRO
    int "The micro version of firmware"
    range 0 9
    default 0
```

## components/cli/Kconfig
```kconfig
menuconfig EZIOT_COMPONENT_CLI_ENABLE
    bool "Enable cli"
    default y

config EZIOT_COMPONENT_CLI_USE_CONSTRUCTOR
    bool "use attribute constructor"
    default y
    depends on EZIOT_COMPONENT_CLI_ENABLE
```

## components/double_link_list/Kconfig
```kconfig
menu "Component double_link_list configuration"
    config EZIOT_COMPONENT_DOUBLE_LINK_LIST_ENABLE
        bool "Enable double_link_list component"
        default y
endmenu
```

## components/easylogger/Kconfig
```kconfig
menu "Component easylogger configuration"
    config EZIOT_COMPONENT_ELOG_ENABLE
        bool "Enable easylogger component"
        default y

    config EZIOT_COMPONENT_ELOG_OUTPUT_ENABLE
        bool "Enable log output"
        default y
        depends on EZIOT_COMPONENT_ELOG_ENABLE

    config EZIOT_COMPONENT_ELOG_ASSERT_ENABLE
        bool "Enable assert check"
        default n
        depends on EZIOT_COMPONENT_ELOG_ENABLE

    config EZIOT_COMPONENT_ELOG_LINE_BUF_SIZE
        int "Buffer size for every line's log"
        range 512 16384
        default 1024
        depends on EZIOT_COMPONENT_ELOG_ENABLE

    config EZIOT_COMPONENT_ELOG_LINE_NUM_MAX_LEN
        int "Output line number max length"
        default 5
        depends on EZIOT_COMPONENT_ELOG_ENABLE

    config EZIOT_COMPONENT_ELOG_FILTER_TAG_MAX_LEN
        int "Output filter's tag max length"
        default 16
        depends on EZIOT_COMPONENT_ELOG_ENABLE

    config EZIOT_COMPONENT_ELOG_FILTER_KW_MAX_LEN
        int "Output filter's keyword max length"
        default 16
        depends on EZIOT_COMPONENT_ELOG_ENABLE

    config EZIOT_COMPONENT_ELOG_FILTER_TAG_LVL_MAX_NUM
        int "Output filter's tag level max num"
        range 0 5
        default 5
        depends on EZIOT_COMPONENT_ELOG_ENABLE

    config EZIOT_COMPONENT_ELOG_NEWLINE_SIGN
        string "Output newline sign"
        default "\n"
        depends on EZIOT_COMPONENT_ELOG_ENABLE

    config EZIOT_COMPONENT_ELOG_COLOR_ENABLE
        bool "Enable log color"
        default y
        depends on EZIOT_COMPONENT_ELOG_ENABLE

    config EZIOT_COMPONENT_ELOG_ASYNC_OUTPUT_ENABLE
        bool "Enable asynchronous output mode"
        default n
        depends on EZIOT_COMPONENT_ELOG_ENABLE

    config EZIOT_COMPONENT_ELOG_ASYNC_LINE_OUTPUT
        bool "Each asynchronous output's log which must end with newline sign"
        default y
        depends on EZIOT_COMPONENT_ELOG_ENABLE && EZIOT_COMPONENT_ELOG_ASYNC_OUTPUT_ENABLE

    config EZIOT_COMPONENT_ELOG_ASYNC_OUTPUT_USING_PTHREAD
        bool "Asynchronous output mode using POSIX pthread implementation"
        default y
        depends on EZIOT_COMPONENT_ELOG_ENABLE && EZIOT_COMPONENT_ELOG_ASYNC_OUTPUT_ENABLE

    config EZIOT_COMPONENT_ELOG_BUF_OUTPUT_ENABLE
        bool "Enable buffered output mode"
        default n
        depends on EZIOT_COMPONENT_ELOG_ENABLE

endmenu
```

## components/ezconn/Kconfig
```kconfig
menu "Component ezconn configuration"
    config EZIOT_COMPONENT_EZCONN_ENABLE
        bool "Enable ezconn component"
        default y

    config EZIOT_COMPONENT_EZCONN_HTTPD_STACK_SIZE
        int "Stack size of httpd server used by distribute"
        default 8192
        depends on EZIOT_COMPONENT_EZCONN_ENABLE

endmenu
```

## components/ezlist/Kconfig
```kconfig
menu "Component ezlist configuration"
    config EZIOT_COMPONENT_EZLIST_ENABLE
        bool "Enable ezlist component"
        default y
endmenu
```

## components/eztimer/Kconfig
```kconfig
menu "Component eztimer configuration"
    config EZIOT_COMPONENT_EZTIMER_ENABLE
        bool "Enable eztimer component"
        default y
    config EZIOT_CONPONENT_TIMER_TASK_STACK_SIZE
        int "Stack size of timer task"
        default 4096
        depends on EZIOT_COMPONENT_EZTIMER_ENABLE
endmenu
```

## components/ezutil/Kconfig
```kconfig
menu "Component ezutil configuration"
osource "${EZOS_PATH}/components/ezutil/*/Kconfig"
endmenu
```

## components/ezutil/lstlib/Kconfig
```kconfig
config EZIOT_COMPONENT_EZUTIL_LST_ENABLE
    bool "Enable lstlib module"
    default y
```

## components/ezutil/misc/Kconfig
```kconfig
config EZIOT_COMPONENT_EZUTIL_MISC_ENABLE
    bool "Enable misc module"
    default y
```

## components/ezutil/s2j/Kconfig
```kconfig
config EZIOT_COMPONENT_EZUTIL_S2J_ENABLE
    bool "Enable uuid module"
    default y
```

## components/ezutil/uuid/Kconfig
```kconfig
config EZIOT_COMPONENT_EZUTIL_UUID_ENABLE
    bool "Enable uuid module"
    default y
```

## components/ezxml/Kconfig
```kconfig
menu "Component ezxml configuration"
    config EZIOT_COMPONENT_EZXML_ENABLE
        bool "Enable ezxml"
        default y
endmenu
```

## components/http_server/Kconfig
```kconfig
menuconfig EZIOT_COMPONENT_EZHTTPD_ENABLE
    bool "Enable http_server"
    default y

config EZIOT_COMPONENT_EZHTTPD_STACK_SIZE
    int "Stack size of httpd server"
    default 4096
    depends on EZIOT_COMPONENT_EZHTTPD_ENABLE

config EZIOT_COMPONENT_EZHTTPD_SERVER_PORT
    int "port of httpd server"
    default 80
    depends on EZIOT_COMPONENT_EZHTTPD_ENABLE
```

## components/logger/Kconfig
```kconfig
menu "Component logger configuration"
    config EZIOT_COMPONENT_LOGGER_ENABLE
        bool "Enable logger"
        default y
endmenu
```

## components/mbedtls/Kconfig
```kconfig
menu "component mbedtls configuration"
    config EZIOT_COMPONENT_MBEDTLS_ENABLE
        bool "Enable mbedtls"
        default y
endmenu
```

## components/mqtt/Kconfig
```kconfig
menu "Component mqtt configuration"
    config EZIOT_COMPONENT_MQTT_ENABLE
        bool "Enable mqtt client"
        default y
endmenu
```

## components/utest/Kconfig
```kconfig
menu "Component utest configuration"
    config EZIOT_COMPONENT_UTEST_ENABLE
        bool "Enable utest"
        default n
endmenu
```

## components/webclient/Kconfig
```kconfig
menu "Component webclient configuration"
    config EZIOT_COMPONENT_WEBCLIENT_ENABLE
        bool "Enable webclient component"
        default y
endmenu
```

## examples/example_action/Kconfig
```kconfig
menuconfig EZIOT_EXAMPLES_ACTION_ENABLE
    bool "Enable example action"
    default n
    depends on EZIOT_EXAMPLES_ENABLE
```

## examples/example_bind/Kconfig
```kconfig
menuconfig EZIOT_EXAMPLES_BIND_ENABLE
    bool "Enable example bind"
    default n
    depends on EZIOT_EXAMPLES_ENABLE
```

## examples/example_event/Kconfig
```kconfig
menuconfig EZIOT_EXAMPLES_EVENT_ENABLE
    bool "Enable example event"
    default n
    depends on EZIOT_EXAMPLES_ENABLE
```

## examples/example_gateway/Kconfig
```kconfig
menu "ez-iot shadow configuration"
    config EZIOT_SHADOW_ENABLE
        bool "Enable ez-iot shadow"
        default n

endmenu
```
